## ext_tree/Config.in
```kconfig
menu "Custom packages"
	source "../ext_tree/package/aprenderer/Config.in"
	source "../ext_tree/package/aplayer/Config.in"
	source "../ext_tree/package/naa/Config.in"
	source "../ext_tree/package/roonready/Config.in"
	source "../ext_tree/package/librespot/Config.in"
	source "../ext_tree/package/apscream/Config.in"
	source "../ext_tree/package/scream/Config.in"
	source "../ext_tree/package/squeezeliteR2/Config.in"
	source "../ext_tree/package/status-monitor/Config.in"
	source "../ext_tree/package/qobuz-connect-assert-hook/Config.in"
	source "../ext_tree/package/celmusper-i2s-shim/Config.in"
	source "../ext_tree/package/qobuz-connect/Config.in"
	source "../ext_tree/package/tidal-connect/Config.in"
	source "../ext_tree/package/uac2_router/Config.in"
	source "../ext_tree/package/buffer_daemon/Config.in"
	source "../ext_tree/package/dlna_bridge/Config.in"
	source "../ext_tree/package/snd-screamalsa/Config.in"
	source "../ext_tree/package/volume-encoder/Config.in"
endmenu
```

## ext_tree/package/scream/Config.in
```kconfig
config BR2_PACKAGE_SCREAM
    bool "scream"
    select BR2_PACKAGE_ALSA_LIB
    help
      Scream network audio receiver (ALSA output).
```
